/* activate bluetooth */
#define CONFIG_WIRELESS

#define ZMK_BASE_LAYER(name, LT, RT, LM, RM, LB, RB, LH, RH)                   \
    ZMK_LAYER(                                                                 \
        name,                                                                  \
                 LT RT                                                         \
                 LM RM                                                         \
                 LB RB                                                         \
                 LH RH                                                         \
    )

/* source key position labels */
#include "zmk-helpers/key-labels/34.h"

/* source the main keymap */
#include "base.keymap"